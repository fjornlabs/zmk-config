## config/boards/shields/custom100/Kconfig.defconfig
```kconfig
if SHIELD_CUSTOM100_LEFT || SHIELD_CUSTOM100_RIGHT

config ZMK_KEYBOARD_NAME
    default "Custom100"

config ZMK_SPLIT
    default y

if SHIELD_CUSTOM100_LEFT

config ZMK_SPLIT_ROLE_CENTRAL
    default y

endif # SHIELD_CUSTOM100_LEFT

endif # SHIELD_CUSTOM100_LEFT || SHIELD_CUSTOM100_RIGHT
```

## config/boards/shields/custom100/Kconfig.shield
```kconfig
config SHIELD_CUSTOM100_LEFT
    def_bool $(shields_list_contains,custom100_left)

config SHIELD_CUSTOM100_RIGHT
    def_bool $(shields_list_contains,custom100_right)
```
